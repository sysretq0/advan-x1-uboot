## configs/mt6789_advan_x1_defconfig
```kconfig
CONFIG_ARM=y
CONFIG_COUNTER_FREQUENCY=13000000
CONFIG_POSITION_INDEPENDENT=y
CONFIG_ARCH_MEDIATEK=y
CONFIG_TEXT_BASE=0x60000000
CONFIG_SYS_MALLOC_F_LEN=0x8000
CONFIG_NR_DRAM_BANKS=2
CONFIG_DEFAULT_DEVICE_TREE="mt6789-advan-x1"
CONFIG_OF_LIBFDT_OVERLAY=y
CONFIG_OF_BOARD_FIXUP=y
CONFIG_TARGET_MT6789=y
CONFIG_SYS_LOAD_ADDR=0x61000000
CONFIG_FIT=y
CONFIG_BOOTSTD_FULL=y
CONFIG_BOOTDELAY=2
CONFIG_USE_BOOTCOMMAND=y
CONFIG_BOOTCOMMAND="bootmenu"
CONFIG_BOARD_LATE_INIT=y
CONFIG_SYS_CONSOLE_IS_IN_ENV=y
CONFIG_HUSH_PARSER=y
CONFIG_CMD_BOOTI=y
CONFIG_CMD_BOOTM=y
CONFIG_CMD_BOOTMENU=y
CONFIG_CMD_CLK=y
CONFIG_CMD_EXT4=y
CONFIG_CMD_FAT=y
CONFIG_CMD_FS_GENERIC=y
CONFIG_CMD_GPT=y
CONFIG_CMD_PART=y
CONFIG_CMD_PMIC=y
CONFIG_CMD_SCSI=y
CONFIG_CMD_SYSBOOT=y
CONFIG_CMD_UFS=y
CONFIG_CMD_FASTBOOT=y
CONFIG_EFI_PARTITION=y
CONFIG_OF_CONTROL=y
CONFIG_ENV_IS_NOWHERE=y
CONFIG_BUTTON=y
CONFIG_BUTTON_REMAP_PHONE_KEYS=y
CONFIG_BUTTON_MTK_KEYS=y
CONFIG_DM_GPIO=y
CONFIG_DM_KEYBOARD=y
CONFIG_BUTTON_KEYBOARD=y
CONFIG_CLK=y
CONFIG_FASTBOOT_BUF_ADDR=0x62000000
CONFIG_FASTBOOT_BUF_SIZE=0x08000000
CONFIG_FASTBOOT_FLASH=y
CONFIG_FASTBOOT_FLASH_BLOCK=y
CONFIG_FASTBOOT_FLASH_BLOCK_INTERFACE_NAME="scsi"
CONFIG_FASTBOOT_FLASH_BLOCK_DEVICE_ID=2
CONFIG_PHY=y
CONFIG_PHY_MTK_TPHY=y
CONFIG_DM_PMIC=y
CONFIG_DM_PMIC_MTK_PWRAP=y
CONFIG_SCSI=y
CONFIG_DM_SCSI=y
CONFIG_BAUDRATE=921600
CONFIG_DM_SERIAL=y
CONFIG_MTK_SERIAL=y
CONFIG_SYSRESET=y
CONFIG_SYSRESET_PSCI=y
CONFIG_UFS=y
CONFIG_UFS_MEDIATEK=y
CONFIG_USB=y
CONFIG_USB_GADGET=y
CONFIG_USB_GADGET_MANUFACTURER="Advan"
CONFIG_USB_GADGET_VENDOR_NUM=0x0e8d
CONFIG_USB_GADGET_PRODUCT_NUM=0x201c
CONFIG_USB_MUSB_GADGET=y
CONFIG_USB_MUSB_MTK=y
CONFIG_USB_FUNCTION_FASTBOOT=y
CONFIG_VIDEO=y
CONFIG_VIDEO_SIMPLE=y
CONFIG_VIDEO_ANSI=y
CONFIG_VIDEO_FONT_8X16=y
CONFIG_CONSOLE_NORMAL=y
CONFIG_WDT=y
CONFIG_WDT_MTK=y
```
